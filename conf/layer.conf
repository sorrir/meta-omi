## conf/layer.conf
```bitbake
# We have a conf and classes directory, add to BBPATH
BBPATH .= ":${LAYERDIR}"

# We have recipes-* directories, add to BBFILES
BBFILES += "${LAYERDIR}/recipes-*/*/*.bb \
            ${LAYERDIR}/recipes-*/*/*.bbappend"

BBFILE_COLLECTIONS += "meta-omi"
BBFILE_PATTERN_meta-omi = "^${LAYERDIR}/"
BBFILE_PRIORITY_meta-omi = "6"

LAYERDEPENDS_meta-omi = "core"
LAYERSERIES_COMPAT_meta-omi = "warrior"
```
